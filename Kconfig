## Kconfig
```kconfig
config CO5300_QSPI
    bool "CO5300 QSPI AMOLED display"
    default y if DT_HAS_WAVESHARE_CO5300_QSPI_ENABLED
    depends on SPI && GPIO && SPI_EXTENDED_MODES
    depends on DT_HAS_WAVESHARE_CO5300_QSPI_ENABLED
    help
      RGB565 AMOLED panel used by the Waveshare ESP32-S3 Touch AMOLED 2.16.

config ZMK_DONGLE_SCREEN_ENGINE
    bool "Dongle Theme engine"
    default y if SHIELD_DONGLE_SCREEN_HOST
    select ZMK_DONGLE_SCREEN_DIRECT_RGB565

config ZMK_DONGLE_SCREEN_FPS
    int "Theme animation deadline frequency (not a guaranteed physical refresh rate)"
    default 60
    range 1 60
    depends on ZMK_DONGLE_SCREEN_ENGINE

config ZMK_DONGLE_SCREEN_OPTIMIZE_SPEED
    bool "Favor renderer throughput over minimum firmware size"
    default n
    depends on ZMK_DONGLE_SCREEN_ENGINE
    help
      Compile Engine raster and transport code with -O3. Enable only after
      checking the final firmware map against the board's Flash budget.
      Use Q8 distance and Q15 arc coverage with a symmetric distance table.

config ZMK_DONGLE_SCREEN_MAX_THROUGHPUT
    bool "Immediately continue an over-budget animation"
    default n
    depends on ZMK_DONGLE_SCREEN_ENGINE
    help
      When a completed animation frame already exceeds the configured frame
      period, yield the display queue for 1 ms and render the next frame
      instead of waiting for another FPS grid boundary. Explicit Theme
      deadlines remain authoritative. This does not alter Theme pixels or
      animation time and is intended for measured slow themes.

config ZMK_DONGLE_SCREEN_DONGLE_BATTERY
    bool "The dongle has a physical battery (otherwise show only split 0/1)"
    default n
    depends on ZMK_DONGLE_SCREEN_ENGINE

config ZMK_DONGLE_SCREEN_BRIGHTNESS
    int "Display backlight percent"
    default 40
    range 0 100
    depends on ZMK_DONGLE_SCREEN_ENGINE

config ZMK_DONGLE_SCREEN_DIRECT_RGB565
    bool "Send ABI 1.4 RGB565 output directly through the display driver"
    default y
    depends on ZMK_DONGLE_SCREEN_ENGINE
    help
      Required by Theme ABI 1.4. LVGL retains screen lifecycle ownership while
      the Engine presents either a full framebuffer or bounded regions directly.

config ZMK_DONGLE_SCREEN_HD_480
    bool "Enable 480x480 AMOLED scene capacity"
    depends on ZMK_DONGLE_SCREEN_ENGINE
    help
      Allows a 480x480 Theme and 30x30 damage tiles. A full RGB565 frame
      occupies 460800 bytes; use external PSRAM for the HD full-frame backend.

config ZMK_DONGLE_SCREEN_HD_DOUBLE_BUFFER
    bool "Two 480x480 RGB565 scene buffers in ESP32-S3 PSRAM"
    depends on ZMK_DONGLE_SCREEN_HD_480 && ZMK_DONGLE_SCREEN_BACKEND_FULL_FRAMEBUFFER
    depends on SOC_SERIES_ESP32S3 && ESP_SPIRAM
    help
      Places two 460800-byte scenes in external PSRAM. The Theme renders an
      entire next scene off-screen, then tile hashing transfers only changed
      RGB565 regions. The display write path remains synchronous.

choice ZMK_DONGLE_SCREEN_RENDER_BACKEND
    prompt "Theme rendering backend"
    default ZMK_DONGLE_SCREEN_BACKEND_FULL_FRAMEBUFFER
    depends on ZMK_DONGLE_SCREEN_DIRECT_RGB565

config ZMK_DONGLE_SCREEN_BACKEND_FULL_FRAMEBUFFER
    bool "Full framebuffer (default, simplest and fastest for full-screen animation)"

config ZMK_DONGLE_SCREEN_BACKEND_COHERENT_STRIP
    bool "Coherent strips (lower RAM, redraws each strip)"

config ZMK_DONGLE_SCREEN_BACKEND_DIRTY_REGION
    bool "Dirty regions (lowest transfer volume, most tuning)"

endchoice

config ZMK_DONGLE_SCREEN_FULL_FRAMEBUFFER
    bool "Legacy full-framebuffer selection (use render backend choice)"
    default n
    depends on ZMK_DONGLE_SCREEN_BACKEND_FULL_FRAMEBUFFER
    help
      Compatibility symbol for existing build configurations. The selected
      render backend now controls framebuffer allocation and presentation.

config ZMK_DONGLE_SCREEN_FILTER_CRT
    bool "Apply the lightweight CRT glass filter"
    default n
    depends on ZMK_DONGLE_SCREEN_ENGINE
    help
      Add asymmetric non-linear edge darkening, rounded black corners and a
      weak top highlight after Theme drawing. This performs no barrel warp and
      allocates no additional framebuffer.

config ZMK_DONGLE_SCREEN_FILTER_CRT_CORNER_RADIUS
    int "CRT filter inner corner radius (px)"
    default 24
    range 1 120
    depends on ZMK_DONGLE_SCREEN_FILTER_CRT
    help
      Radius of the filter's inner black glass corners in physical panel
      pixels. The value is clamped to half of the shortest screen side.

config ZMK_DONGLE_SCREEN_STRIP_PIXELS
    int "Maximum RGB565 pixels in the firmware render strip"
    default 4480
    range 4480 31360
    depends on ZMK_DONGLE_SCREEN_DIRECT_RGB565 && !ZMK_DONGLE_SCREEN_BACKEND_FULL_FRAMEBUFFER
    help
      Bounds static render RAM independently of display area. 4480 pixels are
      sixteen full rows at 280 pixels wide and require 8960 bytes. 31360
      pixels hold 112 rows (62720 bytes), below nRF EasyDMA's 65535-byte limit.

config ZMK_DONGLE_SCREEN_REGION_TILE_HASH
    bool "Pack changed tiles during continuous region animation"
    default n
    depends on ZMK_DONGLE_SCREEN_DIRECT_RGB565 && !ZMK_DONGLE_SCREEN_BACKEND_FULL_FRAMEBUFFER
    help
      Hash and pack changed 16x16 tiles for continuous region animation.
      This lowers payload but creates more LCD windows. Disabled mode sends
      each rendered strip in order for stronger spatial coherence.

config ZMK_DONGLE_SCREEN_STARTUP_DELAY_MS
    int "Black screen settling time before the first theme frame (ms)"
    default 0
    range 0 5000
    depends on ZMK_DONGLE_SCREEN_ENGINE

config ZMK_DONGLE_SCREEN_SPLASH_MS
    int "Theme splash duration (ms)"
    default 1000
    range 0 5000
    depends on ZMK_DONGLE_SCREEN_ENGINE

config ZMK_DONGLE_SCREEN_DIAL_REVEAL_MS
    int "Theme reveal-stage duration (ms)"
    default 500
    range 0 5000
    depends on ZMK_DONGLE_SCREEN_ENGINE

config ZMK_DONGLE_SCREEN_DISTANCE_LUT
    bool "Use exact float distance lookup (64 KiB flash, no extra framebuffer)"
    default n
    depends on ZMK_DONGLE_SCREEN_ENGINE

config ZMK_DONGLE_SCREEN_PACKED_RECTS
    bool "Pack exact dirty rectangles for display transport (4 KiB scratch)"
    default y
    depends on ZMK_DONGLE_SCREEN_DIRECT_RGB565
    help
      Compatibility option retained for existing configurations. The ABI 1.4
      dirty-region backend packs exact changed rectangles from its strip.
```

## boards/shields/dongle_screen_host/Kconfig.shield
```kconfig
config SHIELD_DONGLE_SCREEN_HOST
    def_bool $(shields_list_contains,dongle_screen_host)
```

## boards/shields/dongle_theme_host/Kconfig.shield
```kconfig
config SHIELD_DONGLE_THEME_HOST
    def_bool $(shields_list_contains,dongle_theme_host)
```

## boards/waveshare/esp32s3_touch_amoled_2_16/Kconfig
```kconfig
# SPDX-License-Identifier: Apache-2.0
config HEAP_MEM_POOL_ADD_SIZE_BOARD
    int
    default 4096 if BOARD_ESP32S3_TOUCH_AMOLED_2_16_ESP32S3_PROCPU
```

## boards/waveshare/esp32s3_touch_amoled_2_16/Kconfig.defconfig
```kconfig
# SPDX-License-Identifier: Apache-2.0
if BOARD_ESP32S3_TOUCH_AMOLED_2_16_ESP32S3_PROCPU
configdefault LV_COLOR_16_SWAP
    default y if LVGL
endif
```

## boards/waveshare/esp32s3_touch_amoled_2_16/Kconfig.esp32s3_touch_amoled_2_16
```kconfig
# SPDX-License-Identifier: Apache-2.0
config BOARD_ESP32S3_TOUCH_AMOLED_2_16
    select SOC_ESP32S3_WROOM_N16R8
    select SOC_ESP32S3_PROCPU if BOARD_ESP32S3_TOUCH_AMOLED_2_16_ESP32S3_PROCPU
```

## boards/waveshare/esp32s3_touch_amoled_2_16/board.yml
```yaml
board:
  name: esp32s3_touch_amoled_2_16
  full_name: Waveshare ESP32-S3 Touch AMOLED 2.16
  vendor: waveshare
  socs:
  - name: esp32s3
```

## boards/waveshare/esp32s3_touch_amoled_2_16/esp32s3_touch_amoled_2_16_esp32s3_procpu_defconfig
```kconfig
CONFIG_GPIO=y
CONFIG_SPI=y
CONFIG_SPI_EXTENDED_MODES=y
CONFIG_DISPLAY=y
CONFIG_SERIAL=y
CONFIG_CONSOLE=y
CONFIG_UART_CONSOLE=y
CONFIG_CLOCK_CONTROL=y
CONFIG_ESP_SPIRAM=y
CONFIG_SPIRAM_MODE_OCT=y
```

## dts/bindings/display/waveshare,co5300-qspi.yaml
```yaml
description: CO5300 QSPI AMOLED on Waveshare ESP32-S3 Touch AMOLED 2.16
compatible: "waveshare,co5300-qspi"
on-bus: spi
include: spi-device.yaml
properties:
  reset-gpios:
    type: phandle-array
    required: true
  panel-cs-gpios:
    type: phandle-array
    required: true
  width:
    type: int
    const: 480
  height:
    type: int
    const: 480
```
